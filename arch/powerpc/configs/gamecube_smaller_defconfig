## arch/powerpc/platforms/embedded6xx/Kconfig
```kconfig
config EMBEDDED6xx
	bool "Embedded 6xx/7xx/7xxx-based boards"
	depends on 6xx && BROKEN_ON_SMP

config LINKSTATION
	bool "Linkstation / Kurobox(HG) from Buffalo"
	depends on EMBEDDED6xx
	select MPIC
	select FSL_SOC
	select PPC_UDBG_16550 if SERIAL_8250
	select DEFAULT_UIMAGE
	select MPC10X_OPENPIC
	select MPC10X_BRIDGE
	help
	  Select LINKSTATION if configuring for one of PPC- (MPC8241)
	  based NAS systems from Buffalo Technology. So far only
	  KuroboxHG has been tested. In the future classical Kurobox,
	  Linkstation-I HD-HLAN and HD-HGLAN versions, and PPC-based
	  Terastation systems should be supported too.

config STORCENTER
	bool "IOMEGA StorCenter"
	depends on EMBEDDED6xx
	select MPIC
	select FSL_SOC
	select PPC_UDBG_16550 if SERIAL_8250
	select MPC10X_OPENPIC
	select MPC10X_BRIDGE
	help
	  Select STORCENTER if configuring for the iomega StorCenter
	  with an 8241 CPU in it.

config MPC7448HPC2
	bool "Freescale MPC7448HPC2(Taiga)"
	depends on EMBEDDED6xx
	select TSI108_BRIDGE
	select DEFAULT_UIMAGE
	select PPC_UDBG_16550
	select TSI108_BRIDGE
	help
	  Select MPC7448HPC2 if configuring for Freescale MPC7448HPC2 (Taiga)
	  platform

config PPC_HOLLY
	bool "PPC750GX/CL with TSI10x bridge (Hickory/Holly)"
	depends on EMBEDDED6xx
	select TSI108_BRIDGE
	select PPC_UDBG_16550
	select TSI108_BRIDGE
	help
	  Select PPC_HOLLY if configuring for an IBM 750GX/CL Eval
	  Board with TSI108/9 bridge (Hickory/Holly)

config PPC_PRPMC2800
	bool "Motorola-PrPMC2800"
	depends on EMBEDDED6xx
	select MV64X60
	select NOT_COHERENT_CACHE
	help
	  This option enables support for the Motorola PrPMC2800 board

config PPC_C2K
	bool "SBS/GEFanuc C2K board"
	depends on EMBEDDED6xx
	select MV64X60
	select NOT_COHERENT_CACHE
	select MTD_CFI_I4
	help
	  This option enables support for the GE Fanuc C2K board (formerly
	  an SBS board).

config TSI108_BRIDGE
	bool
	select PCI
	select MPIC
	select MPIC_WEIRD

config MPC10X_BRIDGE
	bool
	select PPC_INDIRECT_PCI

config MV64X60
	bool
	select PPC_INDIRECT_PCI
	select CHECK_CACHE_COHERENCY

config MPC10X_OPENPIC
	bool

config MPC10X_STORE_GATHERING
	bool "Enable MPC10x store gathering"
	depends on MPC10X_BRIDGE

config GAMECUBE
	bool "Nintendo-GameCube"
	depends on EMBEDDED6xx
	select GAMECUBE_COMMON
	help
	  Select GAMECUBE if configuring for the Nintendo GameCube.
	  More information at: <http://gc-linux.sourceforge.net/>

config WII
	bool "Nintendo-Wii"
	depends on EMBEDDED6xx
	select GAMECUBE_COMMON
	select PPC_LIB_RHEAP if STARLET_IOS
	select USB_ARCH_HAS_EHCI if STARLET_MINI
	select USB_ARCH_HAS_OHCI if STARLET_MINI
	select HAVE_GENERIC_DMA_COHERENT
	help
	  Select WII if configuring for the Nintendo Wii.
	  More information at: <http://gc-linux.sourceforge.net/>

config STARLET_IOS
	bool "Nintendo Wii Starlet IOS support"
	depends on WII
	default y

config STARLET_MINI
	bool "Team Twiizers 'mini' firmware support"
	depends on WII && EXPERIMENTAL
	default y

config FLIPPER_PIC
	bool
	depends on GAMECUBE_COMMON
	default y

config HLWD_PIC
	bool
	depends on STARLET_MINI
	default y

config GAMECUBE_COMMON
	bool
	select NOT_COHERENT_CACHE
	select FLIPPER_PIC
	default n

config GAMECUBE_UDBG
	bool "Nintendo GameCube/Wii udbg support"
	depends on GAMECUBE_COMMON
	default n
	help
	  If you say yes to this option, you will be able to choose between
	  several udbg drivers available for the Nintendo GameCube/Wii.

	  If in doubt, say N here.

choice
	prompt "Nintendo GameCube/Wii udbg drivers"
	depends on GAMECUBE_UDBG

config USBGECKO_UDBG
	bool "USB Gecko udbg console for the Nintendo GameCube/Wii"
	help
	  If you say yes to this option, support will be included for the
	  USB Gecko adapter as an udbg console.
	  The USB Gecko is a EXI to USB Serial converter that can be plugged
	  into a memcard slot in the Nintendo GameCube/Wii.

	  This driver bypasses the EXI layer completely.

	  If in doubt, say N here.

config GAMECUBE_VIDEO_UDBG
	bool "Nintendo GameCube/Wii framebuffer udbg console"
	select FONTS
	select FONT_8x16
	help
	  If you say yes to this option, support will be included for a
	  framebuffer based udbg console for the Nintendo GameCube/Wii.

	  If in doubt, say N here.

endchoice

config GAMECUBE_RSW
	bool "Nintendo GameCube/Wii reset switch/button"
	depends on GAMECUBE_COMMON
	default y
	help
	  If you say yes to this option, support will be included for the
	  reset switch/button of the Nintendo GameCube/Wii.

	  If in doubt, say Y here.

config HLWD_GPIO
	bool "Nintendo Wii (Hollywood) GPIO support"
	depends on GPIOLIB && WII
	default y
	help
	  If you say yes to this option, support will be included for the
	  GPIOs provided by the Hollywood chipset of the Nintendo Wii
	  video game console.
	  Those GPIO lines control, for example, the sensor bar IR leds,
	  the front led, or the eject switch of the disk unit.

	  If in doubt, say Y here.
```

## drivers/exi/Kconfig
```kconfig
#
# Nintendo GameCube EXI (Expansion Interface) support.
#

if GAMECUBE_COMMON

menu "EXI support"

config GAMECUBE_EXI
	bool "Nintendo GameCube/Wii External Interface (EXI)"
	default y
	help
	  On the External Interface sit the memory card slots,
	  serial ports I & II, the Mask ROM, RTC, SRAM and UART.

	  If in doubt, say Y here.

endmenu

endif
```

## drivers/input/si/Kconfig
```kconfig
#
# Nintendo GameCube/Wii Serial Interface (SI) configuration
#

config GAMECUBE_SI
	tristate "Nintendo GameCube/Wii Serial Interface (SI) support"
	depends on GAMECUBE_COMMON
	---help---
	  Say Y here if you want to use the standard pads as joysticks or
	  want to use a keyboard. Everything is autodetected.

	  NOTE: Keyboard detection doesn't work 100%. Building this as a
	  module is recommended, this way you can unload/load the driver
	  to re-detect.
```

## drivers/mmc/core/Kconfig
```kconfig
#
# MMC core configuration
#

config MMC_DISABLE_SPI_CRC
	bool "Disable MMC software CRCs on data blocks"
	help
	  Software CRCs on the data blocks can be a significant (30%)
	  performance cost, and for other reasons may not always be
	  desired.  Select this option to disable it.
	  If unsure, say N.
```

## kernel/Kconfig.hz
```kconfig
#
# Timer Interrupt Frequency Configuration
#

choice
	prompt "Timer frequency"
	default HZ_250
	help
	 Allows the configuration of the timer frequency. It is customary
	 to have the timer interrupt run at 1000 Hz but 100 Hz may be more
	 beneficial for servers and NUMA systems that do not need to have
	 a fast response for user interaction and that may experience bus
	 contention and cacheline bounces as a result of timer interrupts.
	 Note that the timer interrupt occurs on each processor in an SMP
	 environment leading to NR_CPUS * HZ number of timer interrupts
	 per second.


	config HZ_100
		bool "100 HZ"
	help
	  100 Hz is a typical choice for servers, SMP and NUMA systems
	  with lots of processors that may show reduced performance if
	  too many timer interrupts are occurring.

	config HZ_250
		bool "250 HZ"
	help
	 250 Hz is a good compromise choice allowing server performance
	 while also showing good interactive responsiveness even
	 on SMP and NUMA systems. If you are going to be using NTSC video
	 or multimedia, selected 300Hz instead.

	config HZ_300
		bool "300 HZ"
	help
	 300 Hz is a good compromise choice allowing server performance
	 while also showing good interactive responsiveness even
	 on SMP and NUMA systems and exactly dividing by both PAL and
	 NTSC frame rates for video and multimedia work.

	config HZ_1000
		bool "1000 HZ"
	help
	 1000 Hz is the preferred choice for desktop systems and other
	 systems requiring fast interactive responses to events.

	config HZ_10
		bool "10 HZ"
	help
	 10 Hz is an insanely low value considered to be the lowest (practical) frequency as
	 anything below tends to be buggy.  Somewhat defeats the purpose of a tickless kernel.

	 Generally, only servers should attempt this setting due to high latency during GUI related task.

	config HZ_12
		bool "12 HZ"
	help
	 12 Hz is an insanely low value that is targeted towards Servers and command-line systems.
	 Somewhat defeats the purpose of a tickless kernel as power/CPU benefits are negligible.

	 Generally, only Servers should attempt this setting due to high latency during GUI related task.

	config HZ_16
		bool "16 HZ"
	help
	 16 Hz is a low value that is meant mainly for Servers and command-line systems.  During
	 moderate CPU load latency will be very high.  Desktop systems should avoid this value.

	 Generally, only Servers should attempt this setting due to high latency during task.

	config HZ_60
		bool "60 HZ"
	help
	 60 Hz is the lowest value that low-end systems such as the Nintendo Wii can handle before
	 simple task start to become choppy in GUI applications.  Not recommended for desktop use.

	 Gives a slight overall throughput boost at the cost of responsiveness.

	config HZ_175
		bool "175 HZ"
	help
	 175 Hz is considered a compromise between the commonly used default Server value of 100
	  and the default Desktop value of 250 used by most Linux distributions.

	 Being over 1000, driver breakage is likely.

	config HZ_2000
		bool "2000 HZ"
	help
	 2000 Hz is an obscene value to use to run broken software that is Hz
	 limited.

	 Being over 1000, driver breakage is likely.

	config HZ_5000
		bool "5000 HZ"
	help
	 5000 Hz is an obscene value to use to run broken software that is Hz
	 limited.

	 Being over 1000, driver breakage is likely.


endchoice

config HZ
	int
	default 10 if HZ_10
	default 12 if HZ_12
	default 16 if HZ_16
	default 60 if HZ_60
	default 100 if HZ_100
	default 175 if HZ_175
	default 250 if HZ_250
	default 300 if HZ_300
	default 1000 if HZ_1000
	default 2000 if HZ_2000
	default 5000 if HZ_5000

config SCHED_HRTICK
	def_bool HIGH_RES_TIMERS && (!SMP || USE_GENERIC_SMP_HELPERS)
```
